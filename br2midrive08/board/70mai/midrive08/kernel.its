## br2midrive08/board/70mai/midrive08/kernel.its
```
/dts-v1/;

/ {
	description = "Breadbee Firmware";
	#address-cells = <1>;

	images {
		kernel@0 {
			data = /incbin/("../../images/zImage");
			type = "kernel";
			arch = "arm";
			os = "linux";
			compression = "none";
			load = <0x22800000>;
                        entry = <0x22800000>;
			hash@1 {
				algo = "crc32";
			};
			hash@2 {
				algo = "sha1";
			};
		};
		fdt@0 {
			data = /incbin/("../../images/mstar-mercury5-ssc8336n-midrived06.dtb");
			type = "flat_dt";
			arch = "arm";
			compression = "none";
			load = <0x24000000>;
			hash@1 {
				algo = "crc32";
			};
			hash@2 {
				algo = "sha1";
			};
		};
		fdt@1 {
			data = /incbin/("../../images/mstar-mercury5-ssc8336n-midrived08.dtb");
			type = "flat_dt";
			arch = "arm";
			compression = "none";
			load = <0x24000000>;
			hash@1 {
				algo = "crc32";
			};
			hash@2 {
				algo = "sha1";
			};
		};
		fdt@2 {
			data = /incbin/("../../images/mstar-mercury5-ssc8336-mirrorcam.dtb");
			type = "flat_dt";
			arch = "arm";
			compression = "none";
			load = <0x24000000>;
			hash@1 {
				algo = "crc32";
			};
			hash@2 {
				algo = "sha1";
			};
		};
	};

	configurations {
		default = "midrived08";
		midrived06 {
			kernel = "kernel@0";
			fdt = "fdt@0";
		};
		midrived08 {
			kernel = "kernel@0";
			fdt = "fdt@1";
		};
		mirrorcam {
			kernel = "kernel@0";
			fdt = "fdt@2";
		};
	};
};
```
